## meta-myhelloworld/conf/layer.conf
```bitbake
# We have a conf and classes directory, add to BBPATH
BBPATH .= ":${LAYERDIR}"

# We have recipes-* directories, add to BBFILES
BBFILES += "${LAYERDIR}/recipes-*/*/*.bb \
            ${LAYERDIR}/recipes-*/*/*.bbappend"

BBFILE_COLLECTIONS += "meta-myhelloworld"
BBFILE_PATTERN_meta-myhelloworld = "^${LAYERDIR}/"
BBFILE_PRIORITY_meta-myhelloworld = "6"

LAYERDEPENDS_meta-myhelloworld = "core"
LAYERSERIES_COMPAT_meta-myhelloworld = "kirkstone"
```
